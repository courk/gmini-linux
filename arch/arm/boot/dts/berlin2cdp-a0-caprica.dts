/*
 * Caprica BG2CDP A0 board device tree source
 *
 * Copyright (C) 2019 Synaptics Incorporated
 *
 * This program is free software; you can redistribute it and/or modify
 * it under the terms of the GNU General Public License version 2 as
 * published by the Free Software Foundation.
*/

/dts-v1/;
/include/ "berlin2cdp-a0-dongle-common.dtsi"

/ {
	soc {
		opp {
			compatible = "marvell,berlin2cdp-v2-opp";
		};
	};
};
