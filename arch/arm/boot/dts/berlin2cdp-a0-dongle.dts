/*
 * MARVELL BERLIN2CDP Dongle board device tree source
 *
 * Copyright (C) 2019 Synaptics Incorporated
 *
 * Copyright (c) 2013 Marvell International Ltd.
 *		http://www.marvell.com
 *
 * This program is free software; you can redistribute it and/or modify
 * it under the terms of the GNU General Public License version 2 as
 * published by the Free Software Foundation.
*/

/dts-v1/;
/include/ "berlin2cdp-a0-dongle-common.dtsi"
